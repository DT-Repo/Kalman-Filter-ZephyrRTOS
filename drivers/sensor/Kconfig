## drivers/sensor/Kconfig
```kconfig
# Copyright (c) 2021 Nordic Semiconductor ASA
# SPDX-License-Identifier: Apache-2.0

if SENSOR
rsource "icm20948/Kconfig"
endif # SENSOR
```

## drivers/sensor/icm20948/Kconfig
```kconfig
# ICM20948 Six-Axis Motion Tracking device configuration options

# Copyright (c) 2020 TDK Invensense
# SPDX-License-Identifier: Apache-2.0

menuconfig ICM20948
	bool "ICM20948 Nine-Axis Motion Tracking Device"
	default y
	depends on DT_HAS_INVENSENSE_ICM20948_ENABLED
	select I2C
	help
	  Enable driver for ICM20948 I2C-based nine-axis motion tracking device.
```
